## boards/avnet/maaxboard_rt/Kconfig.defconfig
```kconfig
# MaaXBoard RT1176 board

# Copyright 2024 NXP
# SPDX-License-Identifier: Apache-2.0

if BOARD_MAAX_IMXRT1176

# Use External Memory Configuration Data (XMCD) by default when booting primary core (M7)
config EXTERNAL_MEM_CONFIG_DATA
	default y if CPU_CORTEX_M7

config NXP_IMX_EXTERNAL_SDRAM
	default y if CPU_CORTEX_M7

if SECOND_CORE_MCUX && CPU_CORTEX_M4

config BUILD_OUTPUT_INFO_HEADER
	default y

DT_CHOSEN_IMAGE_M4 = nxp,m4-partition

# Adjust the offset of the output image for RT11xx SOC
config BUILD_OUTPUT_ADJUST_LMA
	default "($(dt_chosen_reg_addr_hex,$(DT_CHOSEN_IMAGE_M4)) + \
	$(dt_node_reg_addr_hex,/soc/spi@400cc000,1)) - \
	$(dt_node_reg_addr_hex,/soc/ocram@20200000)"

endif

if DISK_DRIVERS

config IMX_USDHC_DAT3_PWR_TOGGLE
	default y

endif # DISK_DRIVERS

if FLASH_MCUX_FLEXSPI_XIP && MEMC_MCUX_FLEXSPI

choice FLASH_MCUX_FLEXSPI_XIP_MEM_TARGET
	default FLASH_MCUX_FLEXSPI_XIP_MEM_ITCM if CPU_CORTEX_M7
	default FLASH_MCUX_FLEXSPI_XIP_MEM_SRAM if CPU_CORTEX_M4
endchoice

endif # FLASH_MCUX_FLEXSPI_XIP && MEMC_MCUX_FLEXSPI

if NETWORKING

config NET_L2_ETHERNET
	default y if CPU_CORTEX_M7

config ETH_MCUX_PHY_RESET
	default y

endif # NETWORKING

#choice CODE_LOCATION
#	default CODE_ITCM
#endchoice


endif
```

## boards/avnet/maaxboard_rt/Kconfig.maax_imxrt1176
```kconfig
#
# Copyright 2024 NXP
#
# SPDX-License-Identifier: Apache-2.0

config BOARD_MAAX_IMXRT1176
	select SOC_PART_NUMBER_MIMXRT1176DVMAA
	select SOC_MIMXRT1176_CM7 if BOARD_MAAX_IMXRT1176_MIMXRT1176_CM7
	select SOC_MIMXRT1176_CM4 if BOARD_MAAX_IMXRT1176_MIMXRT1176_CM4
```

## modules/imxrt1176_som/Kconfig
```kconfig
# Copyright 2023 NXP
# All rights reserved.
#
# SPDX-License-Identifier: BSD-3-Clause
if (MCUX_USE_BOARD_IMXRT1176_SOM_CM4 || MCUX_USE_BOARD_IMXRT1176_SOM_CM7)

config MCUX_BOARD
    default "imxrt1176_som"

config MCUX_KIT
    default "imxrt1176_som"


#### Board level drivers ####
rsource "xip/Kconfig"
rsource "xmcd/Kconfig"

endif
```

## modules/imxrt1176_som/Kconfig.board
```kconfig
# Copyright 2023 NXP
# All rights reserved.
#
# SPDX-License-Identifier: BSD-3-Clause


config MCUX_USE_BOARD_IMXRT1176_SOM_CM4
    bool "IMXRT1176_SOM [CM4]"
    select MCUX_USE_SOC_MIMXRT1176_CM4
    select MCUX_SOC_PART_MIMXRT1176xxxxx

config MCUX_USE_BOARD_IMXRT1176_SOM_CM7
    bool "IMXRT1176_SOM [CM7]"
    select MCUX_USE_SOC_MIMXRT1176_CM7
    select MCUX_SOC_PART_MIMXRT1176xxxxx
```

## modules/imxrt1176_som/xmcd/Kconfig
```kconfig
# Copyright 2023 NXP
# All rights reserved.
#
# SPDX-License-Identifier: BSD-3-Clause

# driver_xmcd_imxrt1176_som
config MCUX_USE_driver_xmcd_imxrt1176_som
    bool "XMCD Driver"
    select MCUX_USE_driver_common
    help
      XMCD Driver
```
