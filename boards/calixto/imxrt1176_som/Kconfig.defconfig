## boards/calixto/imxrt1176_som/Kconfig.imxrt1176_som
```kconfig
#
#
#

config BOARD_IMXRT1176_SOM
	select SOC_PART_NUMBER_MIMXRT1176CVM8A
	select SOC_MIMXRT1176_CM7 if BOARD_IMXRT1176_SOM_MIMXRT1176_CM7
	select SOC_MIMXRT1176_CM4 if BOARD_IMXRT1176_SOM_MIMXRT1176_CM4
```

## drivers/Kconfig
```kconfig
rsource "iol-master/Kconfig"
rsource "rs-485/Kconfig"
rsource "ism/Kconfig"
rsource "fsk/Kconfig"
rsource "rmc/Kconfig"
rsource "display/Kconfig"
rsource "ethernet/Kconfig"
rsource "video/Kconfig"
rsource "audio/Kconfig"
```

## drivers/audio/Kconfig
```kconfig
# SPDX-License-Identifier: Apache-2.0

if AUDIO_CODEC

config AUDIO_TLV320AIC3106
	bool "TLV320AIC3106 audio codec support"
	default y
	depends on DT_HAS_TI_TLV320AIC3106_ENABLED
	depends on AUDIO_CODEC
	select I2C
	help
	  Enable support for the Texas Instruments TLV320AIC3106 stereo audio
	  codec (I2C control interface, I2S/LJ/RJ audio interface).

endif
```

## drivers/display/Kconfig
```kconfig
if DISPLAY

config WAVESHARE_DSI2DPI
    bool "Waveshare DSI2DPI display bridge driver"
    default y
    depends on DT_HAS_WAVESHARE_DSI2DPI_ENABLED
    select MIPI_DSI
    select I2C
    help
      Enable driver for the Waveshare DSI-to-DPI bridge board.
      The board uses an ICN6211 DSI-to-RGB bridge controlled over
      I2C for backlight and enable, with MIPI DSI video input.

endif # DISPLAY
```

## drivers/ethernet/phy/Kconfig
```kconfig
config PHY_TI_DP83822
	bool "TI DP83822 PHY Driver"
	default y
	depends on DT_HAS_TI_DP83822_ENABLED
	depends on MDIO
	depends on GPIO
	help
	  Enable TI DP83822 Ethernet PHY Driver
```

## drivers/fsk/Kconfig
```kconfig
# FSK Radio Subsystem Kconfig
#
# SPDX-License-Identifier: Apache-2.0

menuconfig FSK
	bool "FSK Radio Subsystem"
	help
	  Enable the FSK/GFSK radio driver subsystem.
	  This is a standalone subsystem that does NOT depend on the
	  Zephyr LoRa subsystem or modify any LoRa APIs.

if FSK

# ---------------------------------------------------------------------------
# Driver
# ---------------------------------------------------------------------------

config FSK_SX1278
	bool "Semtech SX1278 FSK/GFSK driver"
	default y
	depends on DT_HAS_CALIXTO_SX127X_FSK_ENABLED
	select SPI
	select GPIO
	help
	  Enable driver for the Semtech SX1278 transceiver operating
	  in FSK/GFSK packet mode only.  LoRa mode is NOT supported
	  and the LongRangeMode bit is explicitly cleared on init.

	  Supports:
	    - FSK and GFSK (Gaussian shaping BT=0.3/0.5/1.0)
	    - Variable and fixed packet modes
	    - Hardware CRC (CRC-CCITT)
	    - Whitening and Manchester DC-free encoding
	    - Up to 8-byte sync word
	    - AFC (Automatic Frequency Correction)
	    - DIO0 interrupt-driven TX/RX with poll fallback
	    - Blocking fsk_send() / fsk_recv() APIs

config FSK_INIT_PRIORITY
	int "FSK driver initialisation priority"
	default KERNEL_INIT_PRIORITY_DEVICE
	help
	  Kernel device initialisation priority for FSK drivers.
	  Must be higher (later) than the SPI bus init priority (default 50).

config FSK_LOG_LEVEL
	int "FSK driver log level"
	default 3
	range 0 4
	help
	  Log level for the FSK driver subsystem.
	    0 = OFF
	    1 = ERR
	    2 = WRN
	    3 = INF  (default)
	    4 = DBG  (enables full register readback trace after configure)
endif
```

## drivers/iol-master-og/Kconfig
```kconfig
config CCE4511_IOL_PL
    bool "CCE4511 IO-Link Master PHY support"
    depends on SPI && GPIO
     help
      Enables support for the CCE4511 IO-Link Master PHY.
```

## drivers/ism/Kconfig
```kconfig
# Copyright (c) Calixto Systems Pvt Ltd 2026
# SPDX-License-Identifier: Apache-2.0

config ISM
    bool "Input Sensing Module (ISM) driver  [Approach A - periodic sampling]"
    depends on DT_HAS_CALIXTO_ISM_ENABLED && GPIO
    help
      Enable the ISM driver using Approach A from the Zephyr debounce blog:
      periodic GPIO state sampling with a rolling sample buffer.

      A dedicated polling thread wakes every CONFIG_ISM_SAMPLE_PERIOD_MS,
      reads each GPIO pin, and pushes the result into a circular buffer.
      A new state is accepted only when CONFIG_ISM_CONSECUTIVE_SAMPLES
      consecutive identical readings are observed.

      Effective debounce window =
          CONFIG_ISM_CONSECUTIVE_SAMPLES x CONFIG_ISM_SAMPLE_PERIOD_MS

if ISM

config ISM_INIT_PRIORITY
    int "ISM device initialization priority"
    default 90
    range 0 99
    help
      POST_KERNEL init priority. Must be higher (later) than the GPIO
      controller so that GPIO handles are valid at ISM early-init.

config ISM_THREAD_STACK_SIZE
    int "ISM polling thread stack size (bytes)"
    default 1024
    range 512 8192
    help
      Stack size for the ISM polling thread.

config ISM_THREAD_PRIORITY
    int "ISM polling thread scheduling priority"
    default 5
    range -16 14
    help
      Scheduling priority for the ISM polling thread.

config ISM_SAMPLE_PERIOD_MS
    int "GPIO sampling interval (ms)"
    default 50
    range 1 500
    help
      How often the polling thread wakes and samples all GPIO pins.
      The blog recommends 10-25 ms for mechanical contacts.

config ISM_CONSECUTIVE_SAMPLES
    int "Consecutive identical samples required for debounce"
    default 3
    range 2 100
    help
      Number of consecutive identical GPIO readings required before a
      state change is confirmed.

      The rule from the Zephyr debounce blog:
        "If there are X-number of consecutive samples with a changed
         state, we assume the transition really happened."

      Effective debounce window =
          CONFIG_ISM_CONSECUTIVE_SAMPLES x CONFIG_ISM_SAMPLE_PERIOD_MS

      Examples:
        3 x 20 ms = 60 ms   (mechanical switches, push-buttons)
        2 x 10 ms = 20 ms   (hall-effect / solid-state sensors)
        5 x 20 ms = 100 ms  (reed switches with heavy bounce)

module = ISM
module-str = ism
source "subsys/logging/Kconfig.template.log_config"

endif # ISM
```

## drivers/rmc/Kconfig
```kconfig
# Copyright (c) 2026 Calixto System Pvt Ltd
# SPDX-License-Identifier: Apache-2.0

menuconfig RMC
	bool "Remote Message Communication (RMC) Driver"
	help
	  Enables the RMC driver: a transport-agnostic communication
	  interface for the application, backed by a WiFi (ESP32-C3) or
	  SubGHz (FSK) backend selected at RMC_Init() time.
	  Create a node with compatible "calixto,rmc" in your board
	  devicetree to enable RMC on a specific instance.

if RMC

config RMC_INIT_PRIORITY
	int "RMC device driver init priority"
	default KERNEL_INIT_PRIORITY_DEVICE
	help
	  Zephyr device-model init priority for the RMC device itself.
	  This only sets up internal runtime state - it does not start
	  any backend. The backend is started explicitly by the
	  application via RMC_Init().

config RMC_WIFI_BACKEND
	bool "Enable RMC WiFi (ESP32-C3) backend"
	default y
	select JSON_LIBRARY
	select UART_INTERRUPT_DRIVEN
	help
	  Enables the WiFi backend (UART + CHIP_EN GPIO control of an
	  ESP32-C3 module). This is the only fully implemented backend.
	  Requires interrupt-driven UART support from the board's UART
	  driver.

config RMC_SUBGHZ_BACKEND
    bool "Enable RMC SubGHz (SX127x FSK) backend"
    default n
    select SPI
    select FSK
    select SX1278
    help
      Enables the RMC SubGHz (SX127x FSK) backend.

      Requires a "calixto,sx127x-fsk" device node referenced by the
      "subghz-radio" property of the "calixto,rmc" Devicetree node.

      The FSK driver owns the SPI bus, RESET GPIO, and DIO0 GPIO
      resources.

config RMC_SERIAL_BACKEND
	bool "Enable RMC Serial (RS-485) backend"
	default n
	select SERIAL
	select UART_INTERRUPT_DRIVEN
	select RS_485
	help
	  Enables the Serial backend: RMC over a half-duplex RS-485 link
	  (the Calixto rs-485 driver handles the DE line). Frames are the
	  raw application packet wrapped as { <payload> }. Requires an RMC
	  devicetree node with a "serial-uart" phandle to a "calixto,rs-485"
	  device.

if RMC_WIFI_BACKEND
rsource "backends/wifi/Kconfig.wifi"
endif # RMC_WIFI_BACKEND

if RMC_SUBGHZ_BACKEND
rsource "backends/subghz/Kconfig.subghz"
endif # RMC_SUBGHZ_BACKEND

if RMC_SERIAL_BACKEND
rsource "backends/serial/Kconfig.serial"
endif # RMC_SERIAL_BACKEND

module = RMC
module-str = rmc
source "subsys/logging/Kconfig.template.log_config"

endif # RMC
```

## drivers/rmc/backends/serial/Kconfig.serial
```kconfig
# Copyright (c) 2026 Calixto System Pvt Ltd
# SPDX-License-Identifier: Apache-2.0

config RMC_SERIAL_DATA_MAX_LEN
	int "RMC Serial maximum data payload length (bytes)"
	default 64
	help
	  Maximum application payload (the bytes between the { } frame
	  delimiters) in a single RMC Serial frame. Bounds the RX framer
	  buffer, the notify buffer, and the TX frame buffer.

config RMC_SERIAL_RX_RING_SIZE
	int "RMC Serial RX ring buffer size (bytes)"
	default 128
	help
	  Size of the ring buffer between the UART RX ISR and the framing
	  work item.
```

## drivers/rmc/backends/subghz/Kconfig.subghz
```kconfig
# Copyright (c) 2026 Calixto System Pvt Ltd
# SPDX-License-Identifier: Apache-2.0

config RMC_SUBGHZ_PAIRING_TIMEOUT_MS
	int "Pairing window duration (ms)"
	default 20000
	depends on RMC_SUBGHZ_BACKEND
	help
	  Total time the Sub-GHz backend will transmit beacons and wait for
	  an Authentication Request from a Shuttle. After this window expires
	  without completing pairing, a new 5-second window starts (loops
	  indefinitely until pairing succeeds).

config RMC_SUBGHZ_RETRY_COUNT
	int "ACK retry count for acknowledged transmissions"
	default 3
	depends on RMC_SUBGHZ_BACKEND
	help
	  Number of retransmissions after an ACK timeout before giving up
	  and reporting RMC_ERR_RETRY_LIMIT to the application. Does not
	  apply to unacknowledged transmissions (msg_type bit7 = 1).

config RMC_SUBGHZ_DEFAULT_TX_TIMEOUT_MS
	int "Default fsk_send() timeout (ms)"
	default 500
	depends on RMC_SUBGHZ_BACKEND
	help
	  Timeout passed to fsk_send() for each individual over-the-air
	  packet transmission (beacon, auth, config, data). Must be long
	  enough for the packet to be fully transmitted at 38.4 kbps.

config RMC_SUBGHZ_SM_STACK_SIZE
	int "Sub-GHz state-machine thread stack size (bytes)"
	default 3072
	depends on RMC_SUBGHZ_BACKEND

config RMC_SUBGHZ_SM_THREAD_PRIORITY
	int "Sub-GHz state-machine thread priority"
	default 7
	depends on RMC_SUBGHZ_BACKEND
	help
	  Must be lower priority (higher number) than ISRs but high enough
	  to respond to radio events promptly. Default matches the Wi-Fi
	  state-machine thread priority.

config RMC_SUBGHZ_SM_MSGQ_DEPTH
	int "Sub-GHz state-machine event queue depth"
	default 8
	depends on RMC_SUBGHZ_BACKEND
	help
	  Number of events (RX packets, timer ticks, TX requests) that can
	  be queued for the state-machine thread at once. Increase if log
	  warnings about queue-full appear.

config RMC_SUBGHZ_DATA_MAX_LEN
    int "RMC SubGHz maximum data payload length (bytes)"
    range 1 237
    default 237
    help
      Maximum length of the data payload in a single RMC SubGHz packet.
      The maximum allowed value is 237 bytes.

config RMC_SUBGHZ_PAIRING_EXCHANGE_TIMEOUT_MS
    int "Pairing exchange timeout (ms)"
    default 5000
    help
      Time (ms) allowed for the full auth -> pairing success after an
      auth request is received. If the shuttle does not complete the
      exchange within this window, RMC_PAIRING_FAILED_TIMEOUT is reported.

config RMC_SUBGHZ_PAIRING_SCAN_RESP_TIMEOUT_MS
    int "Scanning time extension (ms)"
    default 20000
    help
      Time in milliseconds to extend the timeout for receiving
      the authentication request.
```

## drivers/rmc/backends/wifi/Kconfig.wifi
```kconfig
# Copyright (c) 2026 Calixto System Pvt Ltd
# SPDX-License-Identifier: Apache-2.0

config RMC_WIFI_CHIP_EN_STARTUP_DELAY_MS
	int "ESP32-C3 startup delay after CHIP_EN high (ms)"
	default 500
	help
	  Time to wait after driving CHIP_EN high before sending any
	  WiFi configuration or communication commands, per the RMC
	  hardware requirements.

config RMC_WIFI_CHIP_EN_RESET_LOW_MS
	int "ESP32-C3 CHIP_EN low hold time during reset (ms)"
	default 100
	help
	  Time to hold CHIP_EN low during the ESP32-C3 hardware reset
	  sequence, per the RMC hardware requirements.

config RMC_WIFI_DEFAULT_ACK_RETRY_TIMEOUT_MS
	int "Default ACK/NACK retry timeout (ms)"
	default 2000
	help
	  Default value for struct rmc_wifi_init_cfg.ack_retry_timeout_ms
	  if the application does not override it. Governs ACK/NACK
	  waits, WiFi AP connection retries, and remote TCP connection
	  retries.

config RMC_WIFI_DEFAULT_ACK_RETRY_COUNT
	int "Default ACK/NACK retry count"
	default 3
	help
	  Default value for struct rmc_wifi_init_cfg.ack_retry_count if
	  the application does not override it.

config RMC_WIFI_DEFAULT_HEARTBEAT_TIMEOUT_MS
	int "Default heartbeat timeout (ms)"
	default 10000
	help
	  Default value for struct rmc_wifi_init_cfg.heartbeat_timeout_ms if
	  the application does not override it. Independent of the
	  ACK/NACK retry timeout above.

config RMC_WIFI_THREAD_STACK_SIZE
	int "RMC WiFi state-machine thread stack size"
	default 2048

config RMC_WIFI_THREAD_PRIORITY
	int "RMC WiFi state-machine thread priority"
	default 7
	help
	  Cooperative/preemptive priority (Zephyr convention: lower is
	  higher priority) for the dedicated thread that runs the WiFi
	  backend's connection state machine and owns all UART framing
	  consumption.

config RMC_WIFI_MSGQ_DEPTH
	int "RMC WiFi state-machine event queue depth"
	default 4
	help
	  Number of in-flight events (RX packets, timer expiries, TX
	  requests) the state-machine thread can have queued at once.

config RMC_WIFI_DATA_MAX_LEN
	int "RMC WiFi maximum data payload length (bytes)"
	default 250
	help
	  Maximum length of the data payload in a single RMC WiFi packet.
```

## drivers/rs-485/Kconfig
```kconfig
config RS_485
    bool "RS-485 driver support"
    help
      Enables support for RS-485 communication using UART.

if RS_485

config RS_485_LOG_LEVEL
    int "Default log level"
    default 3
    help
      Select the default log level for the RS-485 driver. The levels are:
      0: None, 1: Error, 2: Warning, 3: Info, 4: Debug.

module = RS_485
module-str = rs-485
source "subsys/logging/Kconfig.template.log_config"

rsource "Kconfig.calixto"

endif # RS_485
```

## drivers/rs-485/Kconfig.calixto
```kconfig
config RS_485_CALIXTO
    bool "Calixto RS-485 driver support"
    default y
    depends on DT_HAS_CALIXTO_RS_485_ENABLED
    help
      Enables support for the Calixto RS-485 driver. 
```
