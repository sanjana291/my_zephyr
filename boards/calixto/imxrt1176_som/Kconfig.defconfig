## dts/bindings/audio/ti,tlv320aic3106.yaml
```yaml
# SPDX-License-Identifier: Apache-2.0

description: |
  Texas Instruments TLV320AIC3106 low-power stereo audio codec.

  The codec is controlled over I2C (SELECT pin tied low). The 7-bit address is
  0b00110xx, where xx = MFP1:MFP0, i.e. 0x18, 0x19, 0x1A or 0x1B.

  Example:

    &lpi2c5 {
        codec: tlv320aic3106@18 {
            compatible = "ti,tlv320aic3106";
            reg = <0x18>;
            reset-gpios = <&gpio9 3 GPIO_ACTIVE_LOW>;
            ti,output-select = "both";
            ti,input-select = "line1";
        };
    };

compatible: "ti,tlv320aic3106"

include: i2c-device.yaml

properties:
  reset-gpios:
    type: phandle-array
    description: |
      Codec RESET pin. The pin is active low, so describe it with
      GPIO_ACTIVE_LOW; the driver then treats "active" as "held in reset".
      The datasheet requires a hardware reset after power-up.

  ti,output-select:
    type: string
    default: "both"
    enum:
      - "headphone"
      - "lineout"
      - "both"
    description: |
      Which analog output drivers the DAC is routed to and powered for.
        "headphone" - HPLOUT / HPROUT
        "lineout"   - LEFT_LOP/M / RIGHT_LOP/M
        "both"      - all four
      Select only what is wired on the board to save power.

  ti,input-select:
    type: string
    default: "line1"
    enum:
      - "line1"
      - "line2"
      - "mic3"
    description: |
      Analog input routed to the ADCs (single-ended, 0 dB input level).
        "line1" - LINE1L -> left ADC, LINE1R -> right ADC
        "line2" - LINE2L -> left ADC, LINE2R -> right ADC
        "mic3"  - MIC3L  -> left ADC, MIC3R  -> right ADC

  ti,micbias:
    type: int
    default: 0
    enum: [0, 1, 2, 3]
    description: |
      MICBIAS output (Page 0, register 25, bits D7-D6).
        0: powered down   1: 2.0 V   2: 2.5 V   3: connected to AVDD

  ti,output-cm:
    type: int
    default: 0
    enum: [0, 1, 2, 3]
    description: |
      Output common-mode voltage (Page 0, register 40, bits D7-D6).
        0: 1.35 V (reset default)   1: 1.5 V   2: 1.65 V   3: 1.8 V

  ti,hp-ac-coupled:
    type: boolean
    description: |
      Set when the headphone outputs use AC-coupling capacitors. When absent
      the outputs are programmed for a capless configuration (Page 0,
      register 14, bit D7). Only bit D7 is programmed; a capless wiring may
      additionally require HPLCOM/HPRCOM settings that this driver does not
      touch.
```

## dts/bindings/ethernet/ti,dp83822.yaml
```yaml
description: Texas Instruments DP83822 10/100 Mbps Ethernet PHY device

compatible: "ti,dp83822"

include: ethernet-phy.yaml

properties:
  ti,rmii-mode:
    type: string
    required: true
    description: |
      RMII clock role for the DP83822.

      "master" - RMII Master (Leader) mode: the PHY uses a 25 MHz crystal
      or CMOS oscillator on its XI pin as the reference clock and drives a
      50 MHz output clock on GPIO3 (RX_D3 pin) to the MAC REF_CLK input.
      Use this when the board provides a 25 MHz source to the PHY and expects
      the PHY to supply the 50 MHz REF_CLK to the MAC.

      "slave"  - RMII Slave (Follower) mode: the MAC supplies a 50 MHz CMOS
      oscillator that feeds the PHY's XI pin directly.  Both the MAC and the
      PHY share the same 50 MHz reference.
      Use this when the board provides a 50 MHz clock to the PHY XI pin.

      Selects RCSR register (0x17) bits:
        RMII_MODE_EN  (bit 5) = 1 in both cases
        RMII_MODE_SEL (bit 7) = 0 for master, 1 for slave

    enum:
      - "master"
      - "slave"
```

## dts/bindings/fsk/calixto,sx127x-fsk.yaml
```yaml
# SPDX-License-Identifier: Apache-2.0

description: |
  Semtech SX1276/SX1278 transceiver (RA-02 module) in FSK/GFSK mode.

compatible: "calixto,sx127x-fsk"

include: spi-device.yaml

properties:
  reset-gpios:
    type: phandle-array
    required: true
    description: |
      GPIO connected to the NRESET pin of the SX1278 (active low).
      The driver will toggle this pin during initialisation.

  dio0-gpios:
    type: phandle-array
    required: true
    description: |
      GPIO connected to DIO0 of the SX1278 (active high, rising edge).
      In FSK packet mode this pin signals:
        - TX: PacketSent
        - RX: PayloadReady
      The driver programs DIO_MAPPING1 bits [7:6] = 00 for both cases,
      which gives PacketSent in TX and PayloadReady in RX.
```

## dts/bindings/gpio/calixto,ism.yaml
```yaml
description: |
  Input Sensing Module (ISM) binding for Zephyr applications.

  Each input sensing channel is represented as a child node
  under the ISM controller node.

compatible: "calixto,ism"

child-binding:
  description: Input sensing channel configuration

  properties:
    gpios:
      type: phandle-array
      required: true
      description: GPIO connected to the input sensing channel.

# examples:
#   - |
#     / {
#         ism {
#             compatible = "calixto,ism";

#             ism_0 {
#                 gpios = <&gpio0 1 GPIO_ACTIVE_LOW>;
#             };

#             ism_1 {
#                 gpios = <&gpio2 3 GPIO_ACTIVE_LOW>;
#             };

#             ism_2 {
#                 gpios = <&gpio3 5 GPIO_ACTIVE_LOW>;
#             };
#         };
#     };
```

## dts/bindings/rmc/calixto,rmc-subghz.yaml
```yaml
description: |
  Calixto RMC SubGHz (SX1276, FSK mode) backend.

  Reserved for the future SubGHz transport. The node and binding exist
  today so devicetree overlays can be prepared in advance; the backend
  driver itself (rmc_subghz.c) currently only implements the interface
  template and returns -ENOTSUP for every operation.

compatible: "calixto,rmc-subghz"

include: base.yaml

properties:
  reset-gpios:
    type: phandle-array
    required: true
    description: |
      GPIO connected to the NRESET pin of the SX1278 (active low).
      The driver will toggle this pin during initialisation.

  dio0-gpios:
    type: phandle-array
    required: true
    description: |
      GPIO connected to DIO0 of the SX1278 (active high, rising edge).
      In FSK packet mode this pin signals:
        - TX: PacketSent
        - RX: PayloadReady
      The driver programs DIO_MAPPING1 bits [7:6] = 00 for both cases,
      which gives PacketSent in TX and PayloadReady in RX.
```

## dts/bindings/rmc/calixto,rmc-wifi.yaml
```yaml
description: |
  Calixto RMC Wi-Fi backend (ESP32-C3 co-processor over UART).

  Implements the "PKT i.MXRT - ESP32-C3" protocol: chip-enable GPIO,
  Wi-Fi configuration, ACK/NACK, Wi-Fi/TCP connection status, heartbeat
  supervision and TX/RX data packets.

compatible: "calixto,rmc-wifi"

include: base.yaml

properties:
  uart:
    type: phandle
    required: true
    description: UART device connected to the ESP32-C3 module.

  enable-gpios:
    type: phandle-array
    required: true
    description: Chip-enable GPIO toggled to power up/down the ESP32-C3.

  heartbeat-timeout-ms:
    type: int
    default: 5000
    description: |
      Maximum time without a heartbeat from the ESP32-C3 before the
      backend reports RMC_EVENT_LINK_ERROR to the application.
```

## dts/bindings/rmc/calixto,rmc.yaml
```yaml
compatible: "calixto,rmc"

include: base.yaml

description: Calixto Remote Message Communication driver

properties:
  wifi-uart:
    type: phandle
    required: false
    description: UART connected to WiFi module

  wifi-enable-gpios:
    type: phandle-array
    required: false
    description: Enable GPIO for WiFi module

  subghz:
    type: phandle
    required: false
    description: >
      SubGHz radio device (e.g. SX1276).
```

## dts/bindings/rs-485/calixto,rs-485.yaml
```yaml
description: |
  RS-485 transceiver binding for Calixto SoC.

compatible: "calixto,rs-485"  

include: uart-device.yaml

properties:
  rs-485-gpio:
    description: |
      GPIO pin used for RS-485 direction control.
    type: phandle-array
    required: true
    specifier-space: gpio
```
